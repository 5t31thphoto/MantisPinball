// FILE: src/mantiscannon/mantiscannon_mode.cpp
// MANTIS CANNON - turn-based artillery duel. Two mantis gun crews lob acorns
// across a destructible ridge until one battery falls silent.
//
// Solo: fight the TIN MANTIS (radio never touched - a practice range costs no
// battery). Battle: 2-player over ESP-NOW using the house convention
// (versus_mode / pet trade): HELLO broadcast at 300 ms, CONFIRM to link,
// deterministic roles by chip id, recv callback that ONLY copies bytes and
// raises flags, dedup by sequence number, BYE + full radio teardown on every
// exit path, 15 s search timeout.
//
// DESYNC-PROOF BY DESIGN (this rewrite exists because the draft wasn't):
//  * Shared world frame. The lower chip id is HOST and is ALWAYS the left
//    cannon on BOTH screens; the other device is always the right cannon.
//    Both screens render the identical battlefield ("YOU" tags your side).
//    There is no mirroring math anywhere, so there are no mirroring bugs.
//  * Shooter-authoritative impact. The shooter simulates its own shell and the
//    MC_SHOT packet carries the authoritative impact point as int16 (the draft
//    truncated y through a uint8_t) plus the aim params for the visual replay.
//    The watcher animates the arc for show but applies the packet's impact.
//  * Victim-authoritative HP. Each device owns its own truth: damage to ME is
//    computed by ME from the authoritative impact, and my hp rides every
//    heartbeat. Rival hp on screen is whatever the rival last reported.
//  * Terrain is generated from the host's seed and mutated only by
//    authoritative impacts, so both copies stay bit-identical.
//
// ART: embedded pixel-art sprite set (mantiscannon_sprites.h) generated by
// tools/gen_cannon_sprites.py - gunner poses, acorn shell, victory crown -
// 4bpp + shared 15-color palette, blitted with h-flip for the right battery.
//
// ECONOMY (event-driven, never per-point): match wins pay XP; eight one-time
// achievements pay XP once each, persisted in a bitmask. NVS "mcannon" blob is
// written only at match end (+ shutdown flush behind a dirty flag).
#include <Arduino.h>
#include <TFT_eSPI.h>
#include <math.h>
#include <WiFi.h>
#include <esp_now.h>
#include <Preferences.h>
#include "mantiscannon_mode.h"
#include "mantiscannon_sprites.h"
#include "../theme_colors.h"
#include "../quests/quest_profile.h"

extern TFT_eSprite fb;
extern bool btnL, btnR, btnL_prev, btnR_prev;

static constexpr int W = 170;
static constexpr int H = 320;

// ---- tuning -----------------------------------------------------------------
static constexpr float MC_GRAV      = 0.045f;   // px/frame^2
static constexpr float MC_VEL_K     = 0.030f;   // power -> px/frame
static constexpr float MC_WIND_K    = 0.0018f;  // wind unit -> px/frame^2
static constexpr int   MC_CRATER_R  = 13;
static constexpr int   MC_DIRECT_R  = 7;        // direct-hit radius
static constexpr int   MC_SPLASH_R  = 26;
static constexpr int   MC_MAX_HP    = 100;
static constexpr int   MC_TERR_MIN  = 150;      // highest ground allowed (y)
static constexpr int   MC_TERR_MAX  = 292;      // deepest crater floor (y)
static constexpr int   MC_LEFT_X    = 28;
static constexpr int   MC_RIGHT_X   = W - 28;
static constexpr uint32_t MC_HELLO_MS   = 300;
static constexpr uint32_t MC_SEARCH_MS  = 15000;
static constexpr uint32_t MC_STATUS_MS  = 2000;
static constexpr uint32_t MC_PEER_LOST  = 12000;
static constexpr uint32_t MC_LONG_MS    = 420;
static constexpr uint32_t MC_ENTER_GUARD= 250;

// ---- persistence ------------------------------------------------------------
static const char* NVS_MC = "mcannon";
struct __attribute__((packed)) McSave {
    uint16_t magic;      // 0x434D 'MC'
    uint8_t  version;
    uint8_t  ach;        // achievement bitmask
    uint16_t wins;       // lifetime wins (either mode)
    uint16_t matches;    // lifetime matches finished
};
static McSave mcSv;
static bool mcDirty = false;

static void mcDefaults() { memset(&mcSv, 0, sizeof(mcSv)); mcSv.magic = 0x434D; mcSv.version = 1; }
static void mcLoad() {
    mcDefaults();
    Preferences p;
    if (!p.begin(NVS_MC, true)) return;
    McSave t;
    size_t n = p.getBytes("blob", &t, sizeof(t));
    p.end();
    if (n == sizeof(t) && t.magic == 0x434D && t.version == 1) mcSv = t;
}
static void mcFlush() {
    if (!mcDirty) return;
    Preferences p;
    if (!p.begin(NVS_MC, false)) return;
    p.putBytes("blob", &mcSv, sizeof(mcSv));
    p.end();
    mcDirty = false;
}

// ---- achievements -----------------------------------------------------------
enum McAch : uint8_t {
    ACH_FIRSTDENT = 0,  // first direct hit
    ACH_DEADEYE,        // 3 direct hits in one match
    ACH_TINSMASH,       // beat the TIN MANTIS
    ACH_DUELIST,        // win a 2-player battle
    ACH_UNTOUCHED,      // win at full hp
    ACH_VETERAN,        // 10 lifetime wins
    ACH_WINDMASTER,     // direct hit in strong wind
    ACH_RAINMAKER,      // direct hit with a mortar lob (angle >= 65)
};
struct McAchDef { const char* name; const char* how; uint8_t xp; };
static const McAchDef ACHS[8] = {
    { "FIRST DENT",  "Land a direct hit",          20 },
    { "DEADEYE",     "3 directs in one match",     40 },
    { "TIN SMASHER", "Defeat the Tin Mantis",      25 },
    { "DUELIST",     "Win a 2-player battle",      50 },
    { "UNTOUCHED",   "Win without a scratch",      60 },
    { "VETERAN",     "10 lifetime wins",           80 },
    { "WINDMASTER",  "Direct hit in strong wind",  30 },
    { "RAINMAKER",   "Direct hit lobbed 65+ deg",  30 },
};
static uint8_t achQueue[4];                    // achievements earned this match
static int     achQueueN = 0;

static void mcAward(uint8_t a) {
    if ((mcSv.ach >> a) & 1) return;
    mcSv.ach |= (uint8_t)(1 << a);
    qpAddXp(ACHS[a].xp);
    mcDirty = true;
    if (achQueueN < 4) achQueue[achQueueN++] = a;
}

// ---- world ------------------------------------------------------------------
// Terrain as a heightfield. Stored as y-offset from 100 so it fits a byte
// (140..300 -> 40..200); the draft shipped raw y through uint8_t and wrapped.
static uint8_t* mcGround = nullptr; /* [W]: heap while open */                   // ground y = 100 + mcGround[x]
static inline int mcGY(int x) {
    if (x < 0) x = 0;
    if (x >= W) x = W - 1;
    return 100 + mcGround[x];
}
static inline void mcSetGY(int x, int y) {
    if (y < MC_TERR_MIN) y = MC_TERR_MIN;
    if (y > MC_TERR_MAX) y = MC_TERR_MAX;
    mcGround[x] = (uint8_t)(y - 100);
}

// Deterministic wind + terrain from a shared seed.
static uint32_t mcSeed = 1;
static uint32_t mcLcg(uint32_t s) { return s * 1664525u + 1013904223u; }

static void mcGenTerrain(uint32_t seed) {
    uint32_t r = mcLcg(seed);
    float p1 = (r >> 8 & 0xFF) * 0.0246f; r = mcLcg(r);
    float p2 = (r >> 8 & 0xFF) * 0.0246f; r = mcLcg(r);
    float a1 = 18.0f + (r >> 8 & 0x1F);   r = mcLcg(r);
    float a2 = 8.0f  + (r >> 8 & 0x0F);
    for (int x = 0; x < W; x++) {
        float fx = (float)x;
        int y = 232 - (int)(sinf(fx * 0.045f + p1) * a1 + sinf(fx * 0.117f + p2) * a2);
        // flatten a pad under each battery so nobody starts in a pit
        if (abs(x - MC_LEFT_X) < 11 || abs(x - MC_RIGHT_X) < 11) y = 230;
        mcSetGY(x, y);
    }
}

static int8_t mcWindForTurn(int turn) {
    uint32_t r = mcLcg(mcSeed ^ (uint32_t)(turn * 2654435761u));
    return (int8_t)((int)(r >> 10 & 0x0F) % 11 - 5);          // -5..+5
}

// Carve a crater. Both devices call this with identical authoritative coords,
// so the heightfields never diverge.
static void mcCrater(int cx, int cy, int r) {
    for (int x = cx - r; x <= cx + r; x++) {
        if (x < 0 || x >= W) continue;
        int dx = x - cx;
        int h = (int)sqrtf((float)(r * r - dx * dx));
        int floorY = cy + h / 2;             // bowl bottom for this column
        int g = mcGY(x);
        if (floorY > g) mcSetGY(x, floorY);  // craters only ever dig down
    }
}

// ---- batteries --------------------------------------------------------------
struct McCannon {
    int   x;            // fixed column
    float y;            // settles onto terrain
    int   hp;
    uint8_t angle;      // 10..80 degrees from horizontal, toward the enemy
    uint8_t power;      // 15..100
    uint8_t pose;       // sprite index 0..3
    int8_t  poseT;      // frames left in a temp pose
};
static McCannon mcL, mcR;                     // world frame: L = host side
static bool  mcIAmLeft = true;                // solo: player is always left
static McCannon& me()   { return mcIAmLeft ? mcL : mcR; }
static McCannon& foe()  { return mcIAmLeft ? mcR : mcL; }

static int mcGroundAt(int cx) {
    int g = 999;
    for (int x = cx - 3; x <= cx + 3; x++) { int y = mcGY(x); if (y < g) g = y; }
    return g;
}

// Settle both cannons onto (possibly freshly cratered) ground. Deterministic on
// both devices; each applies fall damage only to its OWN battery and reports
// hp on the next status beat.
static void mcSettle(bool payFallDamage) {
    McCannon* cs[2] = { &mcL, &mcR };
    for (int i = 0; i < 2; i++) {
        McCannon& c = *cs[i];
        float ny = (float)mcGroundAt(c.x);
        float drop = ny - c.y;
        if (payFallDamage && drop > 16) {
            // both sides deduct locally (terrain is identical, so the numbers
            // match); in battle each device's OWN hp is the authoritative copy
            // and the rival's heartbeat overwrites our copy of theirs anyway
            c.hp -= 4;
            if (c.hp < 0) c.hp = 0;
        }
        c.y = ny;
    }
}

// ---- shell ------------------------------------------------------------------
struct McShell {
    bool  on;
    float x, y, vx, vy;
    int8_t wind;
    int   life;
};
static McShell shell;

static void mcLaunch(bool fromLeft, uint8_t angle, uint8_t power, int8_t wind) {
    const McCannon& c = fromLeft ? mcL : mcR;
    float a = angle * 0.0174533f;
    float v = power * MC_VEL_K;
    float dir = fromLeft ? 1.f : -1.f;
    shell.on = true;
    shell.x = c.x + dir * 10;
    shell.y = c.y - 14;
    shell.vx = cosf(a) * v * dir;
    shell.vy = -sinf(a) * v;
    shell.wind = wind;
    shell.life = 0;
}

// One physics step; returns true when the shell has landed (impact stored) or
// left the world. Substeps when fast, per the stepBall() house pattern.
static int impX, impY;
static bool mcShellStep() {
    if (!shell.on) return false;
    float sp = fabsf(shell.vx) + fabsf(shell.vy);
    int steps = sp > 3.0f ? 2 : 1;
    for (int s = 0; s < steps; s++) {
        shell.vx += shell.wind * MC_WIND_K / steps;
        shell.vy += MC_GRAV / steps;
        shell.x += shell.vx / steps;
        shell.y += shell.vy / steps;
        if (++shell.life > 1400) { shell.on = false; impX = -1000; return true; }
        if (shell.y > H + 30 || shell.x < -60 || shell.x > W + 60) {
            shell.on = false; impX = -1000;              // dud, off the world
            return true;
        }
        int xi = (int)shell.x;
        if (xi >= 0 && xi < W && shell.y >= mcGY(xi)) {
            impX = xi; impY = mcGY(xi);
            shell.on = false;
            return true;
        }
        // direct body hit ends flight early
        McCannon* cs[2] = { &mcL, &mcR };
        for (int i = 0; i < 2; i++) {
            float dx = shell.x - cs[i]->x, dy = shell.y - (cs[i]->y - 8);
            if (dx * dx + dy * dy < 49) {
                impX = (int)shell.x; impY = (int)shell.y;
                shell.on = false;
                return true;
            }
        }
    }
    return false;
}

// Damage a battery takes from an impact (shared formula both devices run).
static int mcDamageTo(const McCannon& c, int ix, int iy) {
    float dx = (float)(c.x - ix), dy = (float)((int)c.y - 8 - iy);
    float d = sqrtf(dx * dx + dy * dy);
    if (d <= MC_DIRECT_R)  return 30 + (int)((MC_DIRECT_R - d) * 1.2f);
    if (d <= MC_SPLASH_R)  return 4 + (int)((MC_SPLASH_R - d) * 0.85f);
    return 0;
}

// ---- fx ---------------------------------------------------------------------
struct McPart { float x, y, vx, vy; uint8_t life; };
static McPart* parts = nullptr; /* [18]: heap while open */
static int    shakeT = 0;

static void mcBoom(int x, int y) {
    for (int i = 0; i < 18; i++) {
        float a = i * 0.349f;
        float v = 0.8f + (i % 5) * 0.55f;
        parts[i] = { (float)x, (float)y, cosf(a) * v, sinf(a) * v - 1.2f, (uint8_t)(18 + (i % 9)) };
    }
    shakeT = 8;
}
static void mcFxTick() {
    for (int i = 0; i < 18; i++) {
        if (!parts[i].life) continue;
        parts[i].vy += 0.09f;
        parts[i].x += parts[i].vx;
        parts[i].y += parts[i].vy;
        parts[i].life--;
    }
    if (shakeT) shakeT--;
}

// ---- protocol ---------------------------------------------------------------
enum McMsgType : uint8_t { MM_HELLO = 1, MM_CONFIRM, MM_START, MM_SHOT, MM_STATUS, MM_REMATCH, MM_BYE };
struct __attribute__((packed)) McMsg {
    uint16_t magic;      // 0x4D43
    uint8_t  type;
    uint8_t  seq;
    uint32_t id;         // sender chip id (mac tail)
    uint32_t seed;       // START
    int16_t  impX, impY; // SHOT: authoritative impact (-1000 = dud)
    uint8_t  angle;      // SHOT: replay params
    uint8_t  power;
    int8_t   wind;
    uint8_t  hp;         // STATUS / SHOT: sender's current hp
    uint8_t  turn;
};
static constexpr uint16_t MC_MAGIC = 0x4D43;
static const uint8_t MC_BCAST[6] = { 0xFF, 0xFF, 0xFF, 0xFF, 0xFF, 0xFF };

// recv side: callback copies + flags ONLY (house rule); tick does the thinking
static volatile bool rxHello, rxConfirm, rxStart, rxShot, rxStatus, rxRematch, rxBye;
static uint8_t  rxMac[6];
static uint32_t rxId;
static uint32_t rxSeed;
static int16_t  rxImpX, rxImpY;
static uint8_t  rxAngle, rxPower, rxHp, rxTurn;
static int8_t   rxWind;
static uint16_t rxShotSeqSeen = 0x1FF;        // dedup; sentinel outside uint8 range

static uint32_t mcMyId = 0;
static uint8_t  mcPeer[6];
static bool     mcPeerKnown = false, mcLinked = false, mcEspReady = false;
static bool     mcConfirmedLocal = false, mcConfirmedPeer = false;
static uint32_t mcLastHello = 0, mcLastStatus = 0, mcLastPeerSeen = 0, mcSearchT0 = 0;
static uint8_t  mcSeq = 0;

static void mcOnRecv(const uint8_t* mac, const uint8_t* data, int len) {
    if ((size_t)len < sizeof(McMsg)) return;
    const McMsg* m = (const McMsg*)data;
    if (m->magic != MC_MAGIC || m->id == mcMyId) return;
    memcpy((void*)rxMac, mac, 6);
    rxId = m->id;
    switch (m->type) {
        case MM_HELLO:   rxHello = true;   break;
        case MM_CONFIRM: rxConfirm = true; break;
        case MM_START:   rxSeed = m->seed; rxStart = true; break;
        case MM_SHOT:
            if ((uint16_t)m->seq != rxShotSeqSeen) {   // ESP-NOW can deliver twice
                rxShotSeqSeen = m->seq;
                rxImpX = m->impX; rxImpY = m->impY;
                rxAngle = m->angle; rxPower = m->power; rxWind = m->wind;
                rxHp = m->hp; rxTurn = m->turn;
                rxShot = true;
            }
            break;
        case MM_STATUS:  rxHp = m->hp; rxStatus = true; break;
        case MM_REMATCH: rxRematch = true; break;
        case MM_BYE:     rxBye = true;     break;
    }
}

static void mcClearRx() {
    rxHello = rxConfirm = rxStart = rxShot = rxStatus = rxRematch = rxBye = false;
}

static void mcSend(McMsgType t, const uint8_t* to) {
    McMsg m; memset(&m, 0, sizeof(m));
    m.magic = MC_MAGIC; m.type = t; m.id = mcMyId; m.seq = ++mcSeq;
    m.hp = (uint8_t)me().hp;
    if (t == MM_START) m.seed = mcSeed;
    esp_now_send(to, (uint8_t*)&m, sizeof(m));
}

static void mcSendShot(int ix, int iy, uint8_t angle, uint8_t power, int8_t wind, uint8_t turn) {
    McMsg m; memset(&m, 0, sizeof(m));
    m.magic = MC_MAGIC; m.type = MM_SHOT; m.id = mcMyId; m.seq = ++mcSeq;
    m.impX = (int16_t)ix; m.impY = (int16_t)iy;
    m.angle = angle; m.power = power; m.wind = wind;
    m.hp = (uint8_t)me().hp; m.turn = turn;
    esp_now_send(mcPeer, (uint8_t*)&m, sizeof(m));
    delay(4);
    esp_now_send(mcPeer, (uint8_t*)&m, sizeof(m));   // double-send, dedup'd by seq
}

static bool mcAddPeer(const uint8_t* mac) {
    esp_now_peer_info_t p; memset(&p, 0, sizeof(p));
    memcpy(p.peer_addr, mac, 6);
    p.channel = 0; p.encrypt = false;
    if (esp_now_is_peer_exist(mac)) return true;
    return esp_now_add_peer(&p) == ESP_OK;
}

static bool mcRadioUp() {
    WiFi.mode(WIFI_STA);
    WiFi.disconnect();
    uint8_t mac[6]; WiFi.macAddress(mac);
    mcMyId = ((uint32_t)mac[3] << 16) | ((uint32_t)mac[4] << 8) | mac[5];
    if (esp_now_init() != ESP_OK) return false;
    esp_now_register_recv_cb(esp_now_recv_cb_t(mcOnRecv));
    mcAddPeer(MC_BCAST);
    return true;
}

static void mcRadioDown(bool sayBye) {
    if (mcEspReady) {
        if (sayBye && mcPeerKnown) mcSend(MM_BYE, mcPeer);
        delay(20);
        esp_now_unregister_recv_cb();
        esp_now_deinit();
        mcEspReady = false;
    }
    WiFi.disconnect(true);
    WiFi.mode(WIFI_OFF);
    mcPeerKnown = mcLinked = false;
    mcConfirmedLocal = mcConfirmedPeer = false;
}

// ---- AI: the TIN MANTIS -----------------------------------------------------
// Samples the real ballistics to find a firing solution, then blurs it by an
// error that shrinks as the fight gets serious. Runs in one tick (~10k cheap
// float steps, nothing at 240 MHz).
static void mcAiSolve(uint8_t& outAngle, uint8_t& outPower, int8_t wind) {
    float bestD = 1e9f;
    int bestA = 45, bestP = 60;
    for (int a = 20; a <= 78; a += 4) {
        for (int p = 25; p <= 100; p += 5) {
            float ar = a * 0.0174533f;
            float v = p * MC_VEL_K;
            float x = mcR.x - 10, y = mcR.y - 14;
            float vx = -cosf(ar) * v, vy = -sinf(ar) * v;
            for (int t = 0; t < 500; t++) {
                vx += wind * MC_WIND_K; vy += MC_GRAV;
                x += vx; y += vy;
                if (y > H + 20 || x < -40 || x > W + 40) { t = 500; x = -500; break; }
                int xi = (int)x;
                if (xi >= 0 && xi < W && y >= mcGY(xi)) break;
            }
            if (x < -400) continue;
            float d = fabsf(x - mcL.x);
            if (d < bestD) { bestD = d; bestA = a; bestP = p; }
        }
    }
    // error shrinks as the Tin Mantis takes damage (drama rubber-band)
    int err = 3 + (mcR.hp * 10) / MC_MAX_HP;             // 3..13 power ticks
    uint32_t r = mcLcg(mcSeed ^ (millis() | 1));
    bestP += (int)(r >> 8 & 0xFF) % (err * 2 + 1) - err;
    r = mcLcg(r);
    bestA += (int)(r >> 8 & 0xFF) % 7 - 3;
    if (bestA < 15) bestA = 15;
    if (bestA > 80) bestA = 80;
    if (bestP < 20) bestP = 20;
    if (bestP > 100) bestP = 100;
    outAngle = (uint8_t)bestA;
    outPower = (uint8_t)bestP;
}

// ─────────────────────────────────────────────────────────────────────────────
//  GAME STATE MACHINE
// ─────────────────────────────────────────────────────────────────────────────
enum McScreen : uint8_t {
    SC_MENU = 0, SC_LOBBY, SC_AIM_ANGLE, SC_AIM_POWER, SC_FLY, SC_WAIT,
    SC_ROUNDEND, SC_ACH, SC_LINKLOST
};
static McScreen scr = SC_MENU;

static int      menuSel   = 0;                  // PRACTICE / BATTLE / MEDALS
static bool     vsAi      = true;
static int      turnNo    = 0;                  // even = left fires, odd = right
static int8_t   wind      = 0;
static float    sweep     = 0;                  // oscillating aim cursor 0..1
static int      sweepDir  = 1;
static bool     shotIsMine= false;              // whose shell is flying
static int      authImpX = -1000, authImpY = 0; // rival's authoritative impact
static uint8_t  pendAngle = 45, pendPower = 60; // staged aim (mine or replayed)
static int      aiPauseT  = 0;
static int      myDirects = 0;                  // directs this match (DEADEYE)
static bool     iWon      = false;
static int      endT      = 0;
static uint32_t enterAt   = 0;
static int      achView   = 0;
static bool     rematchMine = false;
static uint32_t idleT     = 0;
static int      dmgPopVal = 0, dmgPopT = 0, dmgPopX = 0, dmgPopY = 0;

static bool myTurn() {
    bool leftTurn = (turnNo % 2) == 0;
    return leftTurn == mcIAmLeft;
}

// ---- input (taps on release, latched holds) ---------------------------------
static bool lTap, rTap, lHoldFire, rHoldFire;
static bool lDown, rDown, lLongDone, rLongDone;
static uint32_t lDownAt, rDownAt;
static void mcInput() {
    lTap = rTap = lHoldFire = rHoldFire = false;
    uint32_t now = millis();
    if (btnL && !btnL_prev) { lDown = true; lDownAt = now; lLongDone = false; }
    if (btnL && lDown && !lLongDone && now - lDownAt > MC_LONG_MS) { lLongDone = true; lHoldFire = true; }
    if (!btnL && btnL_prev) { if (lDown && !lLongDone) lTap = true; lDown = false; }
    if (btnR && !btnR_prev) { rDown = true; rDownAt = now; rLongDone = false; }
    if (btnR && rDown && !rLongDone && now - rDownAt > MC_LONG_MS) { rLongDone = true; rHoldFire = true; }
    if (!btnR && btnR_prev) { if (rDown && !rLongDone) rTap = true; rDown = false; }
    if (now - enterAt < MC_ENTER_GUARD) { lTap = rTap = lHoldFire = rHoldFire = false; }
}

// ---- match setup ------------------------------------------------------------
static void mcNewMatch(bool solo, uint32_t seed) {
    mcSeed = seed;
    mcGenTerrain(seed);
    mcL = { MC_LEFT_X,  0, MC_MAX_HP, 45, 60, 0, 0 };
    mcR = { MC_RIGHT_X, 0, MC_MAX_HP, 45, 60, 0, 0 };
    mcSettle(false);
    turnNo = 0;
    wind = mcWindForTurn(0);
    myDirects = 0;
    achQueueN = 0;
    rematchMine = false;
    shell.on = false;
    dmgPopT = 0;
    vsAi = solo;
    if (solo) mcIAmLeft = true;
    sweep = 0; sweepDir = 1;
    scr = myTurn() ? SC_AIM_ANGLE : SC_WAIT;
    aiPauseT = 46;
}

// ---- impact application (both the shooter and the watcher land here) --------
static void mcApplyImpact(int ix, int iy, bool shooterIsLeft) {
    if (ix <= -900) {                            // dud off the world: no crater
        turnNo++;
        wind = mcWindForTurn(turnNo);
        sweep = 0; sweepDir = 1;
        scr = myTurn() ? SC_AIM_ANGLE : SC_WAIT;
        aiPauseT = 46;
        return;
    }
    mcBoom(ix, iy);
    mcCrater(ix, iy, MC_CRATER_R);

    // damage: in battle I only compute + apply MY OWN (victim-authoritative);
    // solo computes both. The rival's copy of my hp updates on my next beat.
    McCannon* victim = shooterIsLeft ? &mcR : &mcL;
    int dmg = mcDamageTo(*victim, ix, iy);
    bool victimIsMe = (victim == &me());
    if (vsAi || victimIsMe) {
        victim->hp -= dmg;
        if (victim->hp < 0) victim->hp = 0;
    }
    if (dmg > 0) {
        victim->pose = 2; victim->poseT = 40;
        dmgPopVal = dmg; dmgPopT = 50;
        dmgPopX = victim->x; dmgPopY = (int)victim->y - 34;
    }

    // shooter-side achievement checks (my shell, their battery)
    bool shooterIsMe = (shooterIsLeft == mcIAmLeft);
    if (shooterIsMe && dmg >= 30) {
        myDirects++;
        mcAward(ACH_FIRSTDENT);
        if (myDirects >= 3) mcAward(ACH_DEADEYE);
        if (abs((int)wind) >= 4) mcAward(ACH_WINDMASTER);
        if (pendAngle >= 65) mcAward(ACH_RAINMAKER);
    }

    mcSettle(true);
    if (!vsAi) { mcSend(MM_STATUS, mcPeer); mcLastStatus = millis(); }
}

// ---- round end --------------------------------------------------------------
static void mcFinishMatch(bool won) {
    iWon = won;
    endT = 0;
    mcSv.matches++;
    if (won) {
        mcSv.wins++;
        if (vsAi) { qpAddXp(10); mcAward(ACH_TINSMASH); }
        else      { qpAddXp(35); qpGrantPetXp(9); mcAward(ACH_DUELIST); }
        if (me().hp == MC_MAX_HP) mcAward(ACH_UNTOUCHED);
        if (mcSv.wins >= 10) mcAward(ACH_VETERAN);
        me().pose = 3; me().poseT = 120;
    } else {
        foe().pose = 3; foe().poseT = 120;
        me().pose = 2; me().poseT = 120;
    }
    mcDirty = true;
    mcFlush();                                   // match end = the discrete write
    scr = SC_ROUNDEND;
}

// ─────────────────────────────────────────────────────────────────────────────
//  TICK
// ─────────────────────────────────────────────────────────────────────────────
static void mcTickNet() {
    if (vsAi || !mcEspReady) return;
    uint32_t now = millis();
    if (rxBye) { mcClearRx(); mcRadioDown(false); scr = SC_LINKLOST; return; }
    if (rxStatus) {
        rxStatus = false;
        foe().hp = rxHp;
        mcLastPeerSeen = now;
        if (foe().hp <= 0 && scr != SC_ROUNDEND) mcFinishMatch(true);
    }
    if (rxShot) {
        rxShot = false;
        mcLastPeerSeen = now;
        // replay the rival's shell visually; the IMPACT applied at the end is
        // the packet's authoritative one, never our local re-simulation
        authImpX = rxImpX; authImpY = rxImpY;
        turnNo = rxTurn;                          // adopt shooter's turn count
        wind = rxWind;
        foe().hp = rxHp;                          // hp rides the shot too
        foe().angle = rxAngle; foe().power = rxPower;
        pendAngle = rxAngle; pendPower = rxPower;
        mcLaunch(!mcIAmLeft, rxAngle, rxPower, rxWind);
        shotIsMine = false;
        foe().pose = 1; foe().poseT = 24;
        scr = SC_FLY;
    }
    if (now - mcLastStatus > MC_STATUS_MS && mcLinked) {
        mcSend(MM_STATUS, mcPeer);
        mcLastStatus = now;
    }
    if (mcLinked && now - mcLastPeerSeen > MC_PEER_LOST) {
        mcRadioDown(true);
        if (scr != SC_ROUNDEND) scr = SC_LINKLOST;   // results stay up; radio doesn't
    }
}

static void mcTickLobby() {
    uint32_t now = millis();
    if (now - mcLastHello > MC_HELLO_MS) { mcSend(MM_HELLO, MC_BCAST); mcLastHello = now; }
    if (rxHello && !mcPeerKnown) {
        rxHello = false;
        memcpy(mcPeer, (const void*)rxMac, 6);
        mcAddPeer(mcPeer);
        mcPeerKnown = true;
        mcIAmLeft = (mcMyId < rxId);             // deterministic roles by id
        mcSend(MM_CONFIRM, mcPeer);
        mcConfirmedLocal = true;
    }
    if (rxConfirm && mcPeerKnown) {
        rxConfirm = false;
        mcConfirmedPeer = true;
        if (!mcConfirmedLocal) { mcSend(MM_CONFIRM, mcPeer); mcConfirmedLocal = true; }
    }
    if (mcConfirmedLocal && mcConfirmedPeer && !mcLinked) {
        mcLinked = true;
        mcLastPeerSeen = now;
        if (mcIAmLeft) {                          // host seeds the world
            mcSeed = (uint32_t)esp_random();
            mcSend(MM_START, mcPeer);
            delay(4);
            mcSend(MM_START, mcPeer);             // double-send
            mcClearRx();
            mcNewMatch(false, mcSeed);
        }
    }
    if (mcLinked && !mcIAmLeft && rxStart) {
        rxStart = false;
        mcClearRx();
        mcNewMatch(false, rxSeed);
    }
    if (!mcLinked && now - mcSearchT0 > MC_SEARCH_MS) {
        mcRadioDown(false);
        scr = SC_MENU;                            // fell back; menu offers practice
    }
    if (lTap || lHoldFire) { mcRadioDown(true); scr = SC_MENU; }
}

void mantiscannonTick() {
    mcInput();
    mcFxTick();
    idleT++;
    if (mcL.poseT > 0 && --mcL.poseT == 0) mcL.pose = 0;
    if (mcR.poseT > 0 && --mcR.poseT == 0) mcR.pose = 0;
    if (dmgPopT > 0) dmgPopT--;
    mcTickNet();

    switch (scr) {

    case SC_MENU:
        if (lTap) menuSel = (menuSel + 1) % 3;
        if (rTap) {
            if (menuSel == 0) {
                mcNewMatch(true, (uint32_t)esp_random() | 1);
            } else if (menuSel == 1) {
                mcClearRx();
                mcEspReady = mcRadioUp();
                if (mcEspReady) { mcSearchT0 = millis(); mcLastHello = 0; scr = SC_LOBBY; }
            } else {
                achView = 0; scr = SC_ACH;
            }
        }
        break;

    case SC_LOBBY:
        mcTickLobby();
        break;

    case SC_AIM_ANGLE:
        // barrel sweeps 15..78 automatically; R locks it, timing is the skill
        sweep += 0.016f * sweepDir;
        if (sweep > 1) { sweep = 1; sweepDir = -1; }
        if (sweep < 0) { sweep = 0; sweepDir = 1; }
        me().angle = (uint8_t)(15 + sweep * 63);
        if (rTap) { pendAngle = me().angle; sweep = 0; sweepDir = 1; scr = SC_AIM_POWER; }
        break;

    case SC_AIM_POWER:
        sweep += 0.022f * sweepDir;
        if (sweep > 1) { sweep = 1; sweepDir = -1; }
        if (sweep < 0) { sweep = 0; sweepDir = 1; }
        me().power = (uint8_t)(15 + sweep * 85);
        if (lTap) { sweep = 0; sweepDir = 1; scr = SC_AIM_ANGLE; }    // back out
        if (rTap) {
            pendPower = me().power;
            me().pose = 1; me().poseT = 24;
            mcLaunch(mcIAmLeft, pendAngle, pendPower, wind);
            shotIsMine = true;
            scr = SC_FLY;
        }
        break;

    case SC_FLY:
        if (mcShellStep()) {
            if (shotIsMine && !vsAi) {
                // shooter-authoritative impact goes out before we apply it
                mcSendShot(impX, impY, pendAngle, pendPower, wind, (uint8_t)turnNo);
            }
            // my shots and solo shots land where my sim says; a received shot
            // lands exactly where the shooter's packet says
            int ix = (shotIsMine || vsAi) ? impX : authImpX;
            int iy = (shotIsMine || vsAi) ? impY : authImpY;
            bool shooterLeft = shotIsMine ? mcIAmLeft : !mcIAmLeft;
            mcApplyImpact(ix, iy, shooterLeft);
            if (scr == SC_FLY) {                  // mcApplyImpact handled duds
                if (me().hp <= 0) {
                    mcFinishMatch(false);         // victim-authoritative
                } else if (foe().hp <= 0 && vsAi) {
                    mcFinishMatch(true);          // battle waits for their STATUS
                } else {
                    turnNo++;
                    wind = mcWindForTurn(turnNo);
                    sweep = 0; sweepDir = 1;
                    scr = myTurn() ? SC_AIM_ANGLE : SC_WAIT;
                    aiPauseT = 46;
                }
            }
        }
        break;

    case SC_WAIT:
        if (vsAi) {
            if (aiPauseT > 0) aiPauseT--;
            else {
                uint8_t a, p;
                mcAiSolve(a, p, wind);
                mcR.angle = a; mcR.power = p;
                pendAngle = a; pendPower = p;
                mcR.pose = 1; mcR.poseT = 24;
                mcLaunch(false, a, p, wind);
                shotIsMine = false;
                scr = SC_FLY;
            }
        }
        // battle: stay here until MM_SHOT arrives (mcTickNet flips to SC_FLY)
        break;

    case SC_ROUNDEND:
        endT++;
        if (endT > 40 && rTap) {
            if (vsAi) mcNewMatch(true, (uint32_t)esp_random() | 1);
            else if (mcLinked && !rematchMine) {
                rematchMine = true;               // my vote; resolved below
                mcSend(MM_REMATCH, mcPeer);
                delay(4);
                mcSend(MM_REMATCH, mcPeer);
            }
        }
        // both votes in (order-independent): the host deals the new world
        if (!vsAi && mcLinked && rematchMine && rxRematch) {
            rxRematch = false;
            rematchMine = false;
            if (mcIAmLeft) {
                mcClearRx();
                mcSeed = (uint32_t)esp_random();
                mcSend(MM_START, mcPeer);
                delay(4);
                mcSend(MM_START, mcPeer);
                mcNewMatch(false, mcSeed);
            }
            // joiner: START lands below
        }
        if (!vsAi && mcLinked && rxStart) {       // rematch seed from host
            rxStart = false;
            mcClearRx();
            rematchMine = false;
            mcNewMatch(false, rxSeed);
        }
        if (endT > 40 && (lTap || lHoldFire)) {
            if (!vsAi) mcRadioDown(true);
            scr = SC_MENU;
        }
        break;

    case SC_ACH:
        if (lTap) achView = (achView + 1) % 8;
        if (rTap || lHoldFire) scr = SC_MENU;
        break;

    case SC_LINKLOST:
        if (lTap || rTap) scr = SC_MENU;
        break;
    }
}

// ─────────────────────────────────────────────────────────────────────────────
//  DRAW
// ─────────────────────────────────────────────────────────────────────────────
static void mcBlit(const uint8_t* sp, int sw, int sh, int x, int y, bool hflip) {
    int rowB = (sw + 1) / 2;
    for (int py = 0; py < sh; py++) {
        for (int px = 0; px < sw; px++) {
            uint8_t b = sp[py * rowB + px / 2];
            uint8_t v = (px & 1) ? (b >> 4) : (b & 0x0F);
            if (!v || v > MC_PAL_N) continue;
            int dx = hflip ? (x + sw - 1 - px) : (x + px);
            fb.drawPixel(dx, y + py, MC_PAL[v - 1]);
        }
    }
}

static void mcDrawCannon(const McCannon& c, bool isLeft, int ox, int oy) {
    int sx = c.x - SP_IDLE_W / 2 + ox;
    int sy = (int)c.y - SP_IDLE_H + 2 + oy;
    const uint8_t* sp = c.pose == 1 ? SP_FIRE : c.pose == 2 ? SP_HURT : c.pose == 3 ? SP_WIN : SP_IDLE;
    mcBlit(sp, SP_IDLE_W, SP_IDLE_H, sx, sy, !isLeft);
    // the barrel: a 3 px tube from the carriage pivot at the current elevation
    float a = c.angle * 0.0174533f;
    float dir = isLeft ? 1.f : -1.f;
    int bx = c.x + (int)(dir * 3) + ox;
    int by = (int)c.y - 10 + oy;
    int ex = bx + (int)(cosf(a) * 13 * dir);
    int ey = by - (int)(sinf(a) * 13);
    fb.drawLine(bx, by, ex, ey, TEAL_LIGHT);
    fb.drawLine(bx, by - 1, ex, ey - 1, TEAL_BRIGHT);
    fb.drawLine(bx + 1, by, ex + 1, ey, TEAL_DARK);
}

static void mcDrawWorld() {
    int ox = 0, oy = 0;
    if (shakeT) {
        uint32_t r = mcLcg(idleT * 2654435761u);
        ox = (int)(r >> 8 & 3) - 1;
        oy = (int)(r >> 12 & 3) - 1;
    }
    // sky
    fb.fillSprite(TEAL_DEEP);
    // far ridge silhouette
    for (int x = 0; x < W; x += 2) {
        int y = 120 - (int)(sinf(x * 0.06f + 1.7f) * 8);
        fb.drawPixel(x, y + oy, TEAL_DARK);
    }
    // moon
    fb.fillCircle(W - 26, 34, 6, LIME_PALE);
    fb.fillCircle(W - 29, 32, 5, TEAL_DEEP);
    // terrain columns
    for (int x = 0; x < W; x++) {
        int g = mcGY(x) + oy;
        fb.fillRect(x + ox, g, 1, H - 14 - g, TEAL_DARK);
        fb.drawPixel(x + ox, g, TEAL);
        fb.drawPixel(x + ox, g + 1, TEAL);
    }
    mcDrawCannon(mcL, true, ox, oy);
    mcDrawCannon(mcR, false, ox, oy);
    // shell
    if (shell.on) mcBlit(SP_ACORN, SP_ACORN_W, SP_ACORN_H, (int)shell.x - 4 + ox, (int)shell.y - 4 + oy, shell.vx < 0);
    // particles
    for (int i = 0; i < 18; i++)
        if (parts[i].life) fb.drawPixel((int)parts[i].x + ox, (int)parts[i].y + oy, parts[i].life > 9 ? LIME_PALE : PURPLE_LIGHT);
    // damage popup
    if (dmgPopT > 0) {
        char b[8]; snprintf(b, sizeof(b), "-%d", dmgPopVal);
        fb.setTextDatum(MC_DATUM);
        fb.setTextColor(PURPLE_LIGHT);
        fb.drawString(b, dmgPopX, dmgPopY - (50 - dmgPopT) / 4, 2);
    }
}

static void mcDrawHud() {
    // hp bars + names
    const char* ln = mcIAmLeft ? "YOU" : (vsAi ? "TIN" : "RIVAL");
    const char* rn = mcIAmLeft ? (vsAi ? "TIN" : "RIVAL") : "YOU";
    fb.setTextDatum(TL_DATUM);
    fb.setTextColor(mcIAmLeft ? LIME : TEAL_BRIGHT);
    fb.drawString(ln, 3, 3, 1);
    fb.setTextDatum(TR_DATUM);
    fb.setTextColor(mcIAmLeft ? TEAL_BRIGHT : LIME);
    fb.drawString(rn, W - 3, 3, 1);
    // bars
    int lw = (mcL.hp * 56) / MC_MAX_HP, rw = (mcR.hp * 56) / MC_MAX_HP;
    fb.drawRect(3, 13, 58, 6, TEAL);
    if (lw > 0) fb.fillRect(4, 14, lw, 4, mcL.hp > 30 ? LIME : PURPLE_LIGHT);
    fb.drawRect(W - 61, 13, 58, 6, TEAL);
    if (rw > 0) fb.fillRect(W - 60 + (56 - rw), 14, rw, 4, mcR.hp > 30 ? LIME : PURPLE_LIGHT);
    // wind
    fb.setTextDatum(TC_DATUM);
    fb.setTextColor(TEAL_LIGHT);
    char b[16];
    if (wind == 0) snprintf(b, sizeof(b), "WIND -");
    else snprintf(b, sizeof(b), "WIND %c%d", wind > 0 ? '>' : '<', abs((int)wind));
    fb.drawString(b, W / 2, 3, 1);
    int aw = wind * 3;
    if (aw) {
        fb.drawLine(W / 2 - aw, 15, W / 2 + aw, 15, LIME);
        fb.drawLine(W / 2 + aw, 15, W / 2 + aw - (wind > 0 ? 3 : -3), 12, LIME);
    }
}

static void mcFooter(const char* l, const char* r) {
    fb.fillRect(0, H - 14, W, 14, PURPLE_DARK);
    fb.setTextColor(LIME_PALE);
    fb.setTextDatum(ML_DATUM);
    fb.drawString(l, 4, H - 7, 1);
    fb.setTextDatum(MR_DATUM);
    fb.drawString(r, W - 4, H - 7, 1);
}

static void mcDrawMeters() {
    // aiming meters live in the lower band, over the foreground
    if (scr == SC_AIM_ANGLE) {
        char b[16]; snprintf(b, sizeof(b), "ANGLE %d", (int)me().angle);
        fb.setTextDatum(MC_DATUM);
        fb.setTextColor(LIME_PALE);
        fb.drawString(b, W / 2, H - 44, 2);
        fb.drawRect(14, H - 32, W - 28, 8, TEAL);
        int px = 15 + (int)(sweep * (W - 31));
        fb.fillRect(px, H - 31, 3, 6, LIME);
        mcFooter("", "R: lock angle");
    } else if (scr == SC_AIM_POWER) {
        char b[16]; snprintf(b, sizeof(b), "POWER %d", (int)me().power);
        fb.setTextDatum(MC_DATUM);
        fb.setTextColor(LIME_PALE);
        fb.drawString(b, W / 2, H - 44, 2);
        fb.drawRect(14, H - 32, W - 28, 8, TEAL);
        int fw = (int)(sweep * (W - 30));
        if (fw > 0) fb.fillRect(15, H - 31, fw, 6, sweep > 0.8f ? PURPLE_LIGHT : LIME);
        mcFooter("L: back", "R: FIRE!");
    } else if (scr == SC_WAIT) {
        fb.setTextDatum(MC_DATUM);
        fb.setTextColor(TEAL_LIGHT);
        fb.drawString(vsAi ? "TIN MANTIS IS AIMING..." : "RIVAL IS AIMING...", W / 2, H - 40, 1);
        mcFooter("", "");
    } else {
        mcFooter("", "");
    }
}

static void mcDrawMenu() {
    fb.fillSprite(TEAL_DEEP);
    // marquee art: two batteries + an arcing dotted shot
    for (int x = 0; x < W; x++) {
        int y = 96 - (int)(sinf(x * 0.05f) * 6);
        fb.drawPixel(x, y, TEAL_DARK);
    }
    mcBlit(SP_IDLE, SP_IDLE_W, SP_IDLE_H, 14, 70, false);
    mcBlit(SP_IDLE, SP_IDLE_W, SP_IDLE_H, W - 38, 70, true);
    for (int i = 0; i < 9; i++) {
        float t = i / 8.0f;
        int x = 38 + (int)(t * (W - 76));
        int y = 74 - (int)(sinf(t * 3.14159f) * 30);
        if ((i + (idleT / 6)) % 3 == 0) fb.fillCircle(x, y, 1, LIME_PALE);
    }
    fb.setTextDatum(MC_DATUM);
    fb.setTextColor(LIME_PALE);
    fb.drawString("MANTIS", W / 2, 28, 4);
    fb.drawString("CANNON", W / 2, 50, 4);

    static const char* ITEMS[3] = { "PRACTICE RANGE", "BATTLE A RIVAL", "MEDALS" };
    char sub[3][24];
    snprintf(sub[0], 24, "vs the Tin Mantis");
    snprintf(sub[1], 24, "2P over ESP-NOW");
    {
        int got = 0;
        for (int i = 0; i < 8; i++) if ((mcSv.ach >> i) & 1) got++;
        snprintf(sub[2], 24, "%d/8  -  %u wins", got, (unsigned)mcSv.wins);
    }
    for (int i = 0; i < 3; i++) {
        int y = 120 + i * 52;
        bool sel = (i == menuSel);
        fb.fillRoundRect(10, y, W - 20, 44, 5, sel ? TEAL_DARK : TEAL_DEEP);
        fb.drawRoundRect(10, y, W - 20, 44, 5, sel ? LIME : TEAL_DARK);
        fb.setTextDatum(MC_DATUM);
        fb.setTextColor(sel ? LIME_PALE : TEAL_BRIGHT);
        fb.drawString(ITEMS[i], W / 2, y + 15, 2);
        fb.setTextColor(sel ? TEAL_LIGHT : TEAL_DARK);
        fb.drawString(sub[i], W / 2, y + 32, 1);
    }
    mcFooter("L: next", "R: select");
}

static void mcDrawLobby() {
    fb.fillSprite(TEAL_DEEP);
    fb.setTextDatum(MC_DATUM);
    fb.setTextColor(LIME_PALE);
    fb.drawString("SEEKING A RIVAL", W / 2, 60, 2);
    int dots = (int)((millis() / 400) % 4);
    char b[8] = "";
    for (int i = 0; i < dots; i++) b[i] = '.';
    b[dots] = 0;
    fb.setTextColor(TEAL_BRIGHT);
    fb.drawString(b, W / 2, 80, 2);
    // radar sweep
    float a = (millis() % 2000) * 0.00314f;
    fb.drawCircle(W / 2, 160, 40, TEAL_DARK);
    fb.drawCircle(W / 2, 160, 26, TEAL_DARK);
    fb.drawLine(W / 2, 160, W / 2 + (int)(cosf(a) * 40), 160 + (int)(sinf(a) * 40), LIME);
    fb.setTextColor(TEAL_LIGHT);
    fb.drawString(mcPeerKnown ? "RIVAL FOUND - LINKING" : "hold devices close", W / 2, 226, 1);
    uint32_t left = (MC_SEARCH_MS - (millis() - mcSearchT0)) / 1000;
    char t[16]; snprintf(t, sizeof(t), "%us", (unsigned)left);
    fb.drawString(t, W / 2, 246, 1);
    mcFooter("L: cancel", "");
}

static void mcDrawRoundEnd() {
    mcDrawWorld();
    mcDrawHud();
    fb.fillRoundRect(12, 96, W - 24, 118, 8, TEAL_DEEP);
    fb.drawRoundRect(12, 96, W - 24, 118, 8, iWon ? LIME : PURPLE_LIGHT);
    fb.setTextDatum(MC_DATUM);
    fb.setTextColor(iWon ? LIME : PURPLE_LIGHT);
    fb.drawString(iWon ? "VICTORY!" : "DEFEATED", W / 2, 114, 4);
    if (iWon) mcBlit(SP_CROWN, SP_CROWN_W, SP_CROWN_H, W / 2 - 5, 126, false);
    char b[28];
    fb.setTextColor(TEAL_BRIGHT);
    fb.drawString(iWon ? (vsAi ? "+10 XP" : "+35 XP") : "no XP this time", W / 2, 146, 2);
    // achievements earned this match
    int y = 162;
    for (int i = 0; i < achQueueN && y < 204; i++, y += 14) {
        fb.setTextColor(PURPLE_LIGHT);
        snprintf(b, sizeof(b), "MEDAL: %s +%dXP", ACHS[achQueue[i]].name, ACHS[achQueue[i]].xp);
        fb.drawString(b, W / 2, y, 1);
    }
    if (achQueueN == 0) {
        fb.setTextColor(TEAL_LIGHT);
        snprintf(b, sizeof(b), "wins: %u  matches: %u", (unsigned)mcSv.wins, (unsigned)mcSv.matches);
        fb.drawString(b, W / 2, 170, 1);
    }
    mcFooter("L: menu", vsAi ? "R: rematch"
                       : (mcLinked ? (rematchMine ? "waiting for rival..." : "R: rematch (both)")
                                   : "rival left - L: menu"));
}

static void mcDrawAch() {
    fb.fillSprite(TEAL_DEEP);
    fb.fillRect(0, 0, W, 18, PURPLE_DARK);
    fb.setTextDatum(ML_DATUM);
    fb.setTextColor(LIME_PALE);
    fb.drawString("MEDALS", 4, 9, 1);
    char b[24];
    fb.setTextDatum(MR_DATUM);
    int got = 0;
    for (int i = 0; i < 8; i++) if ((mcSv.ach >> i) & 1) got++;
    snprintf(b, sizeof(b), "%d/8", got);
    fb.drawString(b, W - 4, 9, 1);
    for (int i = 0; i < 8; i++) {
        int y = 24 + i * 35;
        bool have = (mcSv.ach >> i) & 1;
        bool sel = (i == achView);
        fb.fillRoundRect(4, y, W - 8, 32, 4, sel ? TEAL_DARK : TEAL_DEEP);
        fb.drawRoundRect(4, y, W - 8, 32, 4, have ? LIME_DARK : (sel ? TEAL_BRIGHT : TEAL_DARK));
        fb.setTextDatum(ML_DATUM);
        fb.setTextColor(have ? LIME : (sel ? TEAL_LIGHT : TEAL_DARK));
        fb.drawString(ACHS[i].name, 10, y + 9, 1);
        fb.setTextColor(have ? LIME_PALE : TEAL_DARK);
        fb.drawString(ACHS[i].how, 10, y + 22, 1);
        if (have) {
            fb.setTextDatum(MR_DATUM);
            fb.setTextColor(LIME);
            snprintf(b, sizeof(b), "+%d", ACHS[i].xp);
            fb.drawString(b, W - 10, y + 15, 1);
        }
    }
    mcFooter("L: next", "R: back");
}

void mantiscannonDraw() {
    switch (scr) {
    case SC_MENU:     mcDrawMenu();  break;
    case SC_LOBBY:    mcDrawLobby(); break;
    case SC_ACH:      mcDrawAch();   break;
    case SC_LINKLOST:
        fb.fillSprite(TEAL_DEEP);
        fb.setTextDatum(MC_DATUM);
        fb.setTextColor(PURPLE_LIGHT);
        fb.drawString("LINK LOST", W / 2, 130, 4);
        fb.setTextColor(TEAL_LIGHT);
        fb.drawString("the rival wandered off", W / 2, 160, 1);
        mcFooter("", "L/R: menu");
        break;
    case SC_ROUNDEND: mcDrawRoundEnd(); break;
    default:
        mcDrawWorld();
        mcDrawHud();
        mcDrawMeters();
        break;
    }
    fb.pushSprite(0, 0);
}

// ─────────────────────────────────────────────────────────────────────────────
//  LIFECYCLE
// ─────────────────────────────────────────────────────────────────────────────
// ---- house rule: an app holds its working buffers ONLY while it is open ----
// Taken at the very start of Enter, freed at the very end of Shutdown, so a
// closed app costs no RAM and every other app (TLS especially) gets it back.
struct AppHeap_cannon {
    McPart parts[18];
    uint8_t mcGround[W];
};
static AppHeap_cannon* g_heap_cannon = nullptr;
static void heapUp_cannon(){
    if (!g_heap_cannon) g_heap_cannon = (AppHeap_cannon*)malloc(sizeof(AppHeap_cannon));
    if (!g_heap_cannon) return;
    memset(g_heap_cannon, 0, sizeof(AppHeap_cannon));
    parts = g_heap_cannon->parts;
    mcGround = g_heap_cannon->mcGround;
}
static void heapDown_cannon(){
    free(g_heap_cannon); g_heap_cannon = nullptr;
    parts = nullptr;
    mcGround = nullptr;
}

void mantiscannonEnter() {
    heapUp_cannon();                       // first: everything below may use the buffers
    fb.setRotation(0);
    mcLoad();
    scr = SC_MENU;
    menuSel = 0;
    vsAi = true;
    mcIAmLeft = true;
    shell.on = false;
    shakeT = 0;
    achQueueN = 0;
    for (int i = 0; i < 18; i++) parts[i].life = 0;
    mcEspReady = false;
    mcPeerKnown = mcLinked = false;
    mcConfirmedLocal = mcConfirmedPeer = false;
    mcClearRx();
    rxShotSeqSeen = 0x1FF;
    mcSeq = 0;
    enterAt = millis();
    idleT = 0;
    lDown = rDown = false;
    lLongDone = rLongDone = false;
    mcGenTerrain(1);                              // menu backdrop terrain
    mcL = { MC_LEFT_X,  0, MC_MAX_HP, 45, 60, 0, 0 };
    mcR = { MC_RIGHT_X, 0, MC_MAX_HP, 45, 60, 0, 0 };
    mcSettle(false);
}

void mantiscannonShutdown() {
    mcRadioDown(true);                            // BYE + full radio teardown
    mcFlush();                                    // dirty-flag guarded
    heapDown_cannon();                     // last: after saves and radio teardown
}
