// paj7620_drv.cpp - Minimal PAJ7620U2 driver (probe / init / poll).
//
// Init sequence taken verbatim from the Seeed Grove Gesture library
// (PAJ7620U2_20140305.asc register dump, MIT licensed). Stored in flash via
// PROGMEM-style const so it costs no RAM.
#include <Arduino.h>
#include <Wire.h>
#include "paj7620_drv.h"

// ---- low-level I2C helpers -------------------------------------------------
static bool wireBegun = false;

static bool wrReg(uint8_t reg, uint8_t val) {
    Wire.beginTransmission(PAJ7620_I2C_ADDR);
    Wire.write(reg);
    Wire.write(val);
    return Wire.endTransmission() == 0;
}

static bool rdReg(uint8_t reg, uint8_t* out, uint8_t n = 1) {
    Wire.beginTransmission(PAJ7620_I2C_ADDR);
    Wire.write(reg);
    if (Wire.endTransmission(false) != 0) return false;
    if (Wire.requestFrom((int)PAJ7620_I2C_ADDR, (int)n) != n) return false;
    for (uint8_t i = 0; i < n; i++) out[i] = Wire.read();
    return true;
}

// Bank select register (0xEF): 0 = bank0, 1 = bank1.
static bool selectBank(uint8_t bank) { return wrReg(0xEF, bank ? 1 : 0); }

static void ensureWire() {
    if (!wireBegun) {
        Wire.begin(PAJ7620_I2C_SDA, PAJ7620_I2C_SCL);
        Wire.setClock(400000);
        wireBegun = true;
    }
}

// ---- init register array (Seeed PAJ7620U2_20140305.asc) --------------------
static const uint8_t INIT_REGS[][2] PROGMEM = {
    {0xEF,0x00},{0x32,0x29},{0x33,0x01},{0x34,0x00},{0x35,0x01},{0x36,0x00},
    {0x37,0x07},{0x38,0x17},{0x39,0x06},{0x3A,0x12},{0x3F,0x00},{0x40,0x02},
    {0x41,0xFF},{0x42,0x01},{0x46,0x2D},{0x47,0x0F},{0x48,0x3C},{0x49,0x00},
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    {0x7C,0x84},{0x7D,0x03},{0x7E,0x01},
};
static const int INIT_REG_COUNT = (int)(sizeof(INIT_REGS) / sizeof(INIT_REGS[0]));

// ---- public API ------------------------------------------------------------
bool paj7620Probe() {
    ensureWire();
    // The first I2C transaction wakes the part from I2C suspend; the Seeed
    // sequence selects bank 0, waits ~700us, selects bank 0 again, then reads
    // the part ID (0x00 = 0x20, 0x01 = 0x76).
    selectBank(0);
    delayMicroseconds(800);
    if (!selectBank(0)) return false;
    uint8_t id[2] = {0, 0};
    if (!rdReg(0x00, id, 2)) return false;
    return (id[0] == 0x20 && id[1] == 0x76);
}

bool paj7620InitGesture() {
    if (!paj7620Probe()) return false;
    for (int i = 0; i < INIT_REG_COUNT; i++) {
        uint8_t reg = pgm_read_byte(&INIT_REGS[i][0]);
        uint8_t val = pgm_read_byte(&INIT_REGS[i][1]);
        if (!wrReg(reg, val)) return false;
    }
    return selectBank(0);   // leave the part in bank 0 for gesture reads
}

uint8_t paj7620ReadGesture(bool* wave) {
    uint8_t flags[2] = {0, 0};
    // Reading 0x43..0x44 in one go clears both gesture flag registers.
    if (!rdReg(0x43, flags, 2)) { if (wave) *wave = false; return 0; }
    if (wave) *wave = (flags[1] & 0x01) != 0;
    return flags[0];
}
